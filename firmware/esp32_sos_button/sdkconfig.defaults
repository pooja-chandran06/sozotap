## firmware/esp32_sos_button/sdkconfig.defaults
```kconfig
CONFIG_ESP_MAIN_TASK_STACK_SIZE=8192
CONFIG_MBEDTLS_HAVE_TIME=y
CONFIG_MBEDTLS_SERVER_CERT_VERIFY_MODE_REQUIRED=y
CONFIG_ESP_TLS_USING_MBEDTLS=y
CONFIG_LWIP_SNTP_MAX_SERVERS=2
```
